## conf/layer.conf
```bitbake
# We have a conf and classes directory, append to BBPATH
BBPATH .= ":${LAYERDIR}"

# We have a recipes directory containing .bb and .bbappend files, add to BBFILES
BBFILES += "${LAYERDIR}/recipes-*/*.bb \
	    ${LAYERDIR}/recipes-*/images/*.bb \
           "

BBFILE_COLLECTIONS += "remidomo"
BBFILE_PATTERN_remidomo := "^${LAYERDIR}/"
BBFILE_PRIORITY_remidomo = "9"
```
